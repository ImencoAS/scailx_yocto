## meta-b2c/conf/layer.conf
```bitbake
# We might have a conf and classes directory, append to BBPATH
BBPATH .= ":${LAYERDIR}"

# We have a recipes directory, add to BBFILES
BBFILES += "${LAYERDIR}/recipes*/*/*.bb ${LAYERDIR}/recipes*/*/*.bbappend"

BBFILE_COLLECTIONS += "meta-b2c"
BBFILE_PATTERN_meta-b2c := "^${LAYERDIR}/"
BBFILE_PRIORITY_meta-b2c = "90"

LAYERDEPENDS_meta-b2c = ""
# "meta-virtualization"
LAYERSERIES_COMPAT_meta-b2c = "kirkstone"

# PREFERRED_PROVIDER_virtual/docker = "podman"
PREFERRED_RPROVIDER_network-configuration = "networkmanager"

OSTREE_KERNEL_ARGS:qemuarm64 = "console=ttyAMA0 root=LABEL=otaroot rootfstype=ext4 b2c.container='-ti docker://docker.io/library/alpine:latest /bin/sh'"
INITRAMFS_IMAGE = "initramfs-podman-image"
INITRAMFS_FSTYPES = "cpio.gz"
INITRAMFS_IMAGE_BUNDLE  = "1"

IMAGE_ROOTFS_EXTRA_SPACE = "10485760"
```

## videology-bsp-karo/conf/machine/mx8-camera.conf
```bitbake
#@TYPE: Machine
#@NAME: Videology imx8 based camera device
#@SOC: i.MX8MP
#@DESCRIPTION: Machine configuration for Videology imx8 amera based on the KAro QSXP-ML81
#@VERSION: 1

MACHINEOVERRIDES =. "mx8-camera:imx8mp-lpddr4-evk:"
require conf/machine/imx8mp-lpddr4-evk.conf

PREFERRED_PROVIDER_virtual/dtb ?= "karo-devicetrees"

MACHINE_ESSENTIAL_EXTRA_RDEPENDS += "karo-devicetrees"

MACHINE_FEATURES += "optee"
MACHINE_FEATURES:remove = "wifi bluetooth"

RM_WORK_EXCLUDE += "u-boot-imx u-boot-karo linux-karo linux-imx kernel-module-crosslink-lvds2mipi"

# devicetrees are supplied from recipe.
KERNEL_DEVICETREE:mx8-camera = ""
KERNEL_DEVICETREE = ""
# defconfig will be supplied
KBUILD_DEFCONFIG:mx8-camera = ""

UBOOT_CONFIG ??= "sd"
UBOOT_CONFIG[sd] = "imx8mp_evk_scailx_config,sdcard"
UBOOT_CONFIG[mfg] = "imx8mp_evk_scailx_config"

IMAGE_CLASSES += " uuu-loader-image "
IMAGE_FSTYPES:remove = "sdcard.bz2 wic.bz2 wic.bmap"
IMAGE_FSTYPES += 'uuuimg wic'
SOC_DEFAULT_WKS_FILE:mx8-camera ?= "imx-boot-rootfs.wks.in"

# overrides imx-base.inc?
WKS_FILE_DEPENDS:append:mx8 = " ${IMAGE_BOOTLOADER}"
WKS_FILE_DEPENDS:append:mx8m = " ${IMAGE_BOOTLOADER}"

# IMAGE_BOOTLOADER = "imx-boot"

# PREFERRED_PROVIDER_virtual/bootloader = "u-boot-imx"
# PREFERRED_PROVIDER_virtual/bootloader:mx8-camera = "u-boot-imx"
```
